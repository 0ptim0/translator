## CMakeLists.txt
```
if(CONFIG_SYSTEM_HEXED)
  nuttx_add_application(NAME translator)
endif()
```

## Kconfig
```
config TRANSLATOR
	tristate "Translator"
	default n
	depends on HAVE_CXX
	---help---
		Enable the communication bridge daemon
```

## prj.conf
```kconfig
CONFIG_GPIO=y
CONFIG_DEBUG=y
CONFIG_BOOTLOADER_MCUBOOT=n
CONFIG_SHELL=y
CONFIG_NO_OPTIMIZATIONS=y
CONFIG_THREAD_ANALYZER=y
CONFIG_THREAD_ANALYZER_ISR_STACK_USAGE=n
CONFIG_CPP=y
CONFIG_GLIBCXX_LIBCPP=y

CONFIG_NEWLIB_LIBC=y
CONFIG_NEWLIB_LIBC_NANO=y
CONFIG_NEWLIB_LIBC_FLOAT_PRINTF=y
CONFIG_POSIX_API=y
CONFIG_FILE_SYSTEM=y
```

## src/Translator.cpp
```c
#include "Translator.hpp"

#include <fcntl.h>
#include <getopt.h>
#include <stdio.h>
#include <string.h>
#include <syslog.h>
#include <unistd.h>

#include "Interfaces/I2c.hpp"
#include "Interfaces/Spi.hpp"
#include "Interfaces/Uart.hpp"

Translator *Translator::inst = nullptr;

Translator::Translator() {
}

Translator *Translator::getInstance() {
    if (inst != nullptr) {
        return inst;
    }
    return new Translator();
}

int Translator::daemon(int argc, char **argv) {
    auto help = [] {
        printf("Usage: translator [-h] [-v]\n");
        printf("Options:\n");
        printf("  -h \t Display this information\n");
        printf("  -v \t Verbosity\n");
    };
    int opt = 0;
    while ((opt = getopt(argc, argv, "hv")) != -1) {
        switch (opt) {
            case 'v':
                this->dbg_messages = true;
                break;
            default:
                syslog(LOG_ERR, "Unknown argument");
            case 'h':
                help();
                return 1;
        }
    }
    syslog(LOG_DEBUG, "Running daemon...");
    interfaces[0] =
        new uart::Interface("uart2", "/dev/ttyS2", interface::Mode::READ_ONLY);
    interfaces[1] =
        new spi::Interface("spi1", "/dev/spi1", interface::Mode::WRITE_ONLY);
    interfaces[2] =
        new i2c::Interface("i2c1", "/dev/i2c1", interface::Mode::WRITE_ONLY);
    interfaces[0]->init();
    interfaces[1]->init();
    interfaces[2]->init();
    interfaces[0]->connect(interfaces[1]);
    interfaces[0]->connect(interfaces[2]);
    while (1) {
        sleep(60);
    }
    return 0;
}

int Translator::commander(int argc, char **argv) {
    auto help = [] {
        printf("Usage: translator [-h] [-i] [-c]\n");
        printf("Options:\n");
        printf("  -h \t Display this information\n");
        printf("  -i \t Interface\n");
        printf("  -c \t Command\n");
    };
    char *commander_interface = nullptr, *commander_options = nullptr;
    int opt = 0;
    while ((opt = getopt(argc, argv, "hi:o:")) != -1) {
        switch (opt) {
            case 'i':
                commander_interface = optarg;
                break;
            case 'o':
                commander_options = optarg;
                break;
            default:
                syslog(LOG_ERR, "Unknown argument");
            case 'h':
                help();
                return 1;
        }
    }
    if (commander_interface == nullptr || commander_options == nullptr) {
        syslog(LOG_ERR, "Specify both interface and command");
        help();
        return 1;
    }
    for (int i = 0; i < interface::max_interfaces; ++i) {
        if (this->interfaces[i] == nullptr) break;
        if (strncmp(interfaces[i]->name(), commander_interface,
                    interface::name_max_length) == 0) {
            interfaces[i]->configure(commander_options);
            return 0;
        }
    }
    help();
    return 1;
}
```

## src/Translator.hpp
```c
#ifndef TRANSLATOR
#define TRANSLATOR

#include "Base.hpp"

class Translator {
private:
    static Translator *inst;
    interface::Base *interfaces[interface::max_interfaces] = {0};

private:
    Translator();

public:
    Translator(const Translator &) = delete;
    void operator=(const Translator &) = delete;

public:
    static Translator *getInstance();

public:
    int daemon(int argc, char **argv);
    int commander(int argc, char **argv);

private:
    bool dbg_messages = false;
};

#endif  // TRANSLATOR
```
